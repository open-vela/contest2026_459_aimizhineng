## app/hifoss/Kconfig
```kconfig
#
# HiFOSS WiFi + OLED demo (GD32F470V-START)
#

config EXAMPLES_HIFOSS
	tristate "HiFOSS WiFi OLED demo"
	default n
	depends on SPI_DRIVER && DEV_GPIO
	---help---
		HiFOSS demo ported from the GD32F470 bare-metal project:
		SSD1306 OLED on SPI0 (SCK=PA5 MOSI=PA7 CS=PA4 DC=PA6 RES=PA1)
		and ESP8266 AT/MQTT on USART1 (TX=PA2 RX=PA3).

if EXAMPLES_HIFOSS

config EXAMPLES_HIFOSS_PROGNAME
	string "Program name"
	default "hifoss"

config EXAMPLES_HIFOSS_PRIORITY
	int "Task priority"
	default 100

config EXAMPLES_HIFOSS_STACKSIZE
	int "Stack size"
	default 4096

endif # EXAMPLES_HIFOSS
```

## board/gd32f470v_start/Kconfig
```kconfig
#
# For a description of the syntax of this configuration file,
# see the file kconfig-language.txt in the NuttX tools repository.
#

if ARCH_BOARD_CUSTOM

choice
	prompt "Select Console wiring."
	default GD32F470V_START_CONSOLE_BOARD
	---help---
		Select where you will connect the console.

		Eval COM Port:

		Advantage: You have a shield so it is easy.

		Disadvantage: You lose the use of the
		other functions on PA9, PA10

				GD32F470V_START
			USART0 GPIO
			-- ----- --------- -----
			RX    USART0_RX PA10
			TX    USART0_TX PA9
			-- ----- --------- -----

config GD32F470V_START_CONSOLE_BOARD
	bool "Eval COM Connector"
	select GD32_USART0
	select USART0_SERIALDRIVER

config GD32F470V_START_CONSOLE_VIRTUAL
	bool "Virtual COM Port"
	select GD32_USART3
	select USART3_SERIALDRIVER

config GD32F470V_START_CONSOLE_NONE
	bool "No Serial Console"

endchoice # "Select Console wiring"


choice
	prompt "GD32F470V MCU Crystal Selected"
	default GD32F470V_START_USE_HXTAL

config GD32F470V_START_USE_HXTAL
	bool "Use Hxtal as clock source"
	# select GD32F470V_START_HXTAL_VALUE

config GD32F470V_START_USE_IRC16
	bool "Use IRC16M as clock source"

endchoice # MCU Crystal Selection

config GD32F470V_START_HXTAL_VALUE
	int "GD32F470V Start Board Hxtal Value"
	default 25000000
	depends on GD32F470V_START_USE_HXTAL
	---help---
		GD32F470V Start Board Hxtal Value, default is 25MHz.

choice
	prompt "GD32F470 MCU System Frequency"
	default GD32F470V_START_200MHZ

config GD32F470V_START_240MHZ
	bool "240 MHz"

config GD32F470V_START_200MHZ
	bool "200 MHz"

config GD32F470V_START_168MHZ
	bool "168 MHz"

endchoice # CPU Frequency

config BOARD_LOOPSPERMSEC
    int "Board loops-per-millisecond"
    default 13500  if GD32F470V_START_168MHZ
    default 16100  if GD32F470V_START_200MHZ
    default 19300  if GD32F470V_START_240MHZ

config GD32F470V_START_GD25_BLOCKMOUNT
	bool "GD25 serial FLASH auto-mount"
	default n
	depends on NSH_ARCHINIT && GD32F4_SPI5 && MTD_GD25
	---help---
		Automatically initialize the GD25 SPI FLASH driver when NSH starts.

choice
	prompt "GD25 SPI FLASH configuration"
	default GD32F470V_START_GD25_NXFFS
	depends on GD32F470V_START_GD25_BLOCKMOUNT

config GD32F470V_START_GD25_FTL
	bool "Create GD25 SPI FLASH block driver"
	---help---
		Create the MTD driver for the GD25 and "wrap" the GD25 as a standard
		block driver that could then, for example, be mounted using FAT or
		any other file system. Any file system may be used, but there will
		be no wear-leveling.

config GD32F470V_START_GD25_NXFFS
	bool "Create GD25 serial FLASH NXFFS file system"
	depends on FS_NXFFS
	---help---
		Create the MTD driver for the GD25 and mount the GD25 device as
		a wear-leveling, NuttX FLASH file system (NXFFS).  The downside of
		NXFFS is that it can be very slow.

config GD32F470V_START_GD25_LITTLEFS
	bool "Create GD25 serial FLASH LFS file system"
	depends on FS_LITTLEFS
	---help---
		Create the MTD driver for the GD25 and mount the GD25 device as
		a wear-leveling, LittleFS FLASH file system (LFS).

endchoice # GD25 serial FLASH configuration

config GD32F470V_START_AT24_TEST
	bool "I2C0 EEPROM AT2402 write and read test"
	default n
	depends on NSH_ARCHINIT && GD32F4_I2C0 && MTD_AT24XX
	---help---
		Automatically initialize and test the AT24 I2C EEPROM driver when
		NSH starts. After test the I2C0 will be released.

config AT24XX_MTD_BLOCKSIZE
	int "AT24xx MTD block size"
	default 8
	depends on GD32F470V_START_AT24_TEST
	---help---
		The block size must be an even multiple of the pages.
		The page size of AT2402 on the board is 8 Byte.

if GD32F4_TLI

config GD32F4_TLI_FB_BASE
	hex "Framebuffer base address (in SDRAM)"
	default 0xC0200000
	depends on GD32F4_EXMC && GD32F4_EXTERNAL_RAM
	---help---
		Base address of the framebuffer used by the TLI controller.
		This board places the framebuffer in external SDRAM attached through
		EXMC, so the address must stay within the configured SDRAM window.

config GD32F4_TLI_FB_SIZE
	int "Framebuffer total size (bytes)"
	default 261120
	depends on GD32F4_EXMC && GD32F4_EXTERNAL_RAM
	---help---
		Total framebuffer size reserved in SDRAM.
		Set this large enough for the selected resolution, pixel format and
		optional second layer, otherwise the layers will overlap in memory.

config GD32F4_TLI_BACKCOLOR
	hex "TLI background color (ARGB)"
	default 0x00ffffff
	---help---
		Default background color blended behind all enabled TLI layers.

config GD32F4_TLI_L1_COLOR
	hex "TLI Layer 1 default color (ARGB)"
	default 0xFFFFFFFF
	---help---
		Default constant color used when Layer 1 blending requires a fixed
		ARGB value.

choice
	prompt "TLI Layer 1 pixel format"
	default GD32F4_TLI_L1_RGB565

config GD32F4_TLI_L1_L8
	bool "L8 (8-bit CLUT)"

config GD32F4_TLI_L1_RGB565
	bool "RGB565 (16-bit)"

config GD32F4_TLI_L1_RGB888
	bool "RGB888 (24-bit)"

config GD32F4_TLI_L1_ARGB8888
	bool "ARGB8888 (32-bit)"

endchoice # TLI Layer 1 pixel format

config GD32F4_TLI_L1_CHROMAKEYEN
	bool "Enable Layer 1 chroma keying"
	default n
	---help---
		Enable chroma key transparency for TLI Layer 1.

config GD32F4_FB_CMAP
	bool "Enable framebuffer CLUT/CMAP"
	default n
	depends on GD32F4_TLI_L1_L8
	---help---
		Enable color lookup table support for indexed L8 framebuffer mode.
		This is useful for palette-based content and can also be used by the
		IPA path when color map operations are needed.

config GD32F4_TLI_L2
	bool "Enable TLI Layer 2"
	default n
	---help---
		Enable the optional second TLI layer.
		This increases framebuffer memory usage and is typically paired with
		overlay or composition use cases.

if GD32F4_TLI_L2

choice
	prompt "TLI Layer 2 pixel format"
	default GD32F4_TLI_L2_RGB565

config GD32F4_TLI_L2_L8
	bool "L8 (8-bit CLUT)"

config GD32F4_TLI_L2_RGB565
	bool "RGB565 (16-bit)"

config GD32F4_TLI_L2_RGB888
	bool "RGB888 (24-bit)"

config GD32F4_TLI_L2_ARGB8888
	bool "ARGB8888 (32-bit)"

endchoice # TLI Layer 2 pixel format

endif # GD32F4_TLI_L2

endif # GD32F4_TLI

config GD32F4_DCI
	bool "DCI (Digital Camera Interface)"
	select GD32F4_DMA1
	select ARCH_DMA

if GD32F4_DCI

config GD32F4_DCI_DMA_CHANNEL
	int "DCI DMA channel selection"
	default 1
	range 1 2
	---help---
		Select DCI DMA channel mapping:
		1 = DMA1 Channel 1, SubPeripheral 1
		2 = DMA1 Channel 7, SubPeripheral 1

config GD32F4_DCI_DMA_HIGH_PRIORITY
	bool "DCI DMA ultra-high priority"
	default n
	---help---
		Use ultra-high priority for DCI DMA channel.
		Default is high priority.

config GD32F4_DCI_REGDEBUG
	bool "DCI register debug"
	default n
	depends on DEBUG_VIDEO
	---help---
		Enable DCI register level debug output.

endif # GD32F4_DCI

config GD32F4_CAMPREVIEW
	bool "Board-level camera preview (OV2640 -> LCD centre)"
	default n
	depends on GD32F4_DCI && VIDEO_FB
	select VIDEO_STREAM
	select GD32F4_I2C0
	---help---
		Start a kernel thread that continuously captures 320x240 RGB565
		frames from the OV2640 via /dev/video0 and blits them centred on
		the 480x272 TLI framebuffer (/dev/fb0).

		The image is placed at pixel offset (80, 16) so that it appears
		in the middle of the LCD.  This avoids the NX graphics server and
		fixes the 6-split artefact caused by mismatched source/destination
		strides in the upstream camera example.

		Requires CONFIG_GD32F4_DCI and CONFIG_VIDEO_FB to be enabled.

if GD32F4_CAMPREVIEW

config GD32F4_CAMPREVIEW_PRIORITY
	int "Camera preview thread priority"
	default 100
	---help---
		Scheduling priority of the campreview kernel thread.

config GD32F4_CAMPREVIEW_STACKSIZE
	int "Camera preview thread stack size (bytes)"
	default 4096
	---help---
		Stack size for the campreview kernel thread.

config GD32F4_CAMPREVIEW_DURATION
	int "Camera preview run duration (seconds, 0=forever)"
	default 10
	---help---
		How many seconds the camera preview thread will stream video
		to the LCD before stopping and clearing the screen.
		Set to 0 to run indefinitely.

endif # GD32F4_CAMPREVIEW

endif # ARCH_BOARD_CUSTOM
```
